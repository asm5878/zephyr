## drivers/ieee802154/Kconfig.stm32wba
```kconfig
# STMicroelectronics STM32WBAxx 802.15.4 configuration options

# Copyright (c) 2025 STMicroelectronics

menuconfig IEEE802154_STM32WBA
	bool "STM32WBA series IEEE 802.15.4 Driver"
	default y
	depends on DT_HAS_ST_STM32WBA_IEEE802154_ENABLED

if IEEE802154_STM32WBA

config IEEE802154_STM32WBA_RX_BUFFERS
	int "STM32WBA 802.15.4 receive buffers"
	default 16
	range 16 128
	help
	  Number of buffers in 802.15.4 driver serialization host's receive queue.
	  Increase this number if you are expected to be in a noisy environment, handling many
	  end-devices and you have sufficient RAM to allocate memory to buffers.
	  If this value is increased, IEEE802154_STM32WBA_RX_STACK_SIZE value might require
	  to be updated as well.

config IEEE802154_STM32WBA_RX_STACK_SIZE
	int "Driver RX thread stack size"
	default 800
	help
	  This option sets the driver's stack size for its internal RX thread.
	  The default value should be sufficient, but in case it proves to be
	  too low, adjust as needed.

config IEEE802154_STM32WBA_CSMA_CA_ENABLED
	bool "CSMA-CA configuration"
	default y
	help
	  This option enables the CSMA-CA feature.

config IEEE802154_STM32WBA_INIT_PRIO
	int "STM32WBA IEEE 802.15.4 initialization priority"
	default 80
	help
	  Set the initialization priority number. Do not mess with it unless
	  you know what you are doing.

config IEEE802154_STM32WBA_DELAY_TRX_ACC
	int "Clock accuracy for delayed operations"
	default 20
	range 0 255
	help
	  Accuracy of the clock used for scheduling radio delayed operations (delayed transmission
	  or delayed reception), in ppm.

config IEEE802154_STM32WBA_LOG_RX_FAILURES
	bool "Frame reception failures logging"
	help
	  There are few cases where the frame reception failure can happen because of
	  internal causes. These cases are reported forward by general code error.

	  This option enables logging the reason of frame reception failure.
	  It can be helpful for the network traffic analysis but it generates also
	  a lot of log records in a stressed environment.

config IEEE802154_STM32WBA_MAC_DEBUG_TIMING
	bool "MAC timing anomaly logging"
	help
	  Enable anomaly-oriented MAC timing logs in the STM32WBA 802.15.4 driver.
	  When enabled, the driver reports slow TX completion, slow RX delivery
	  after TX, and delayed RX queue dequeue events.

if IEEE802154_STM32WBA_MAC_DEBUG_TIMING

config IEEE802154_STM32WBA_MAC_DEBUG_TX_WARN_MS
	int "TX completion warning threshold (ms)"
	default 20
	range 1 60000
	help
	  Warn when TX completion takes longer than this threshold.

config IEEE802154_STM32WBA_MAC_DEBUG_RX_FROM_TX_DONE_WARN_MS
	int "RX-after-TX-done warning threshold (ms)"
	default 50
	range 1 60000
	help
	  Warn when RX processing happens this long after the most recent TX-done.

config IEEE802154_STM32WBA_MAC_DEBUG_RX_FROM_TX_START_WARN_MS
	int "RX-after-TX-start warning threshold (ms)"
	default 60
	range 1 60000
	help
	  Warn when RX processing happens this long after the most recent TX-start.

config IEEE802154_STM32WBA_MAC_DEBUG_RX_QUEUE_WARN_MS
	int "RX queue dequeue warning threshold (ms)"
	default 5
	range 1 60000
	help
	  Warn when a received frame waits longer than this threshold before the
	  RX thread dequeues it.

endif # IEEE802154_STM32WBA_MAC_DEBUG_TIMING

config NET_L2_CUSTOM_IEEE802154_STM32WBA
	bool "Use ST MAC as L2"
	default y
	depends on NET_L2_CUSTOM_IEEE802154
	help
	  Custom STM32WBA series IEEE 802.15.4 L2 Implementation.

endif # IEEE802154_STM32WBA
```

## dts/bindings/power/st,stm32wba-pwr.yaml
```yaml
# Copyright (c) 2026 STMicroelectronics
# SPDX-License-Identifier: Apache-2.0

title: STM32WBA power controller

description: |
  Power controller of STM32WBA series

  Controls the memory retained in s2ram power state.

compatible: "st,stm32wba-pwr"

include: "st,stm32-dualreg-pwr.yaml"

properties:
  standby-exit-latency-profiling:
    type: boolean
    description: |
      Enables one-shot measurement of the Standby software exit latency.
      The first successful Standby resume measures SoC restoration and
      synchronous device resume using SysTick clocked by LSE. The measured
      value replaces standby-exit-latency-initial-us in the custom PM policy.

      Requires CONFIG_PM_S2RAM, an unused SysTick, enabled LSE, and
      CONFIG_PM_EARLY_SYSTEM_TIMER_RESUME disabled. The SoC defaults to
      CONFIG_PM_POLICY_CUSTOM when this property is present; selecting the
      default PM policy explicitly is not supported with profiling enabled.

      Hardware wakeup and execution outside the measurement interval are not
      included. A single software measurement is not a worst-case bound.
      The power state's exit-latency-us still controls latency-request filtering.

  standby-exit-latency-initial-us:
    type: int
    description: |
      Initial Standby exit latency in microseconds, required when
      standby-exit-latency-profiling is enabled and ignored otherwise.
      Used for state selection and wakeup advance until the first successful
      measurement replaces it. Choose a conservative budget covering hardware
      and software wakeup time; waking too late can hide oscillator startup
      behind an independent radio wakeup request and underestimate resume time.

  retain-sram2:
    type: boolean
    description: |
      Enables retention of SRAM2 while in Standby low-power mode.
      (Standby mode is a suspend-to-RAM power state)

      If this property is present, the entire SRAM2 memory region
      will be retained in Standby mode (all contents preserved).

      If this property is not present, the SRAM2 memory region will
      will not be retained in Standby mode (all contents are lost),
      except if the Zephyr RAM region `/chosen/zephyr,sram` overlaps
      with SRAM2 (in this case, retention is always enabled).

examples:
  - |
    &pwr {
            standby-exit-latency-profiling;
            standby-exit-latency-initial-us = <1500>;
    };
  - |
    /*
     * Not used RAM retained (and so powered) is simply a
     * pointless waste of energy.
     * `/chosen/zephyr,sram` (Zephyr system memory) is mapped on
     * sram0 memory controller.
     * According the required ram, sram0 memory controller will use
     * SRAM1 (up to 448KB) and SRAM2 (up to 64KB) physical banks.
     *
     * Let's imagine a build report shows an application needs
     * 120 KB of RAM and Standby low-power feature is required.
     * In this case only the first 2 pages of SRAM1 will be retained.
     * And SRAM2 is not retained by default.
     * The overlay file can be modified like this:
     */
    sram0: memory@20000000 {
            reg = <0x20000000 DT_SIZE_K(120)>;
    };
  - |
    /*
     * If for any specific reason application needs to retain SRAM2:
     */
    &pwr {
            power-supply = "smps";
            retain-sram2;
            status = "okay";
    };
  - |
    /*
     * If full memory is required, SRAM1 and SRAM2 will be
     * fully retained and the sram0 memory node will appear
     * like this:
     */
    sram0: memory@20000000 {
            reg = <0x20000000 DT_SIZE_K(512)>;
    };
```
